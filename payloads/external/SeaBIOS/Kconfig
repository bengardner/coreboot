## payloads/external/SeaBIOS/Kconfig
```kconfig
if PAYLOAD_SEABIOS
menu SeaBIOS

choice
	prompt "SeaBIOS version"
	default SEABIOS_STABLE

config SEABIOS_STABLE
	bool "1.9.0"
	help
	  Stable SeaBIOS version
config SEABIOS_MASTER
	bool "master"
	help
	  Newest SeaBIOS version
config SEABIOS_CUSTOM
	bool "custom"
	help
	  Use an alternate SeaBIOS repo and/or branch.

endchoice

if SEABIOS_CUSTOM
config SEABIOS_GIT_REPO
	prompt "SeaBIOS GIT Repository"
	default "http://review.coreboot.org/p/seabios.git"
	string
	help
	  Set the SeaBIOS GIT repository URL.
	  The default is http://review.coreboot.org/p/seabios.git

config SEABIOS_GIT_BRANCH
	prompt "SeaBIOS GIT Branch"
	default "master"
	string
	help
	  The branch/tag to check out when building SeaBIOS.

endif

config SEABIOS_ADD_BOOTORDER
	bool "Add a Bootorder file for SeaBIOS to CBFS"
	default n
	help
	  Add a bootorder file to control the boot order in SeaBIOS.
	  for more information go to
	  http://www.coreboot.org/SeaBIOS#Configuring_boot_order

config SEABIOS_BOOTORDER_FILE
	string "bootorder source path and filename"
	depends on SEABIOS_ADD_BOOTORDER
	default ""
	help
	  Add a bootorder file to control the boot order in SeaBIOS.
	  for more information go to
	  http://www.coreboot.org/SeaBIOS#Configuring_boot_order

if BOOTSPLASH
comment 'SeaBIOS will use the bootsplash file that was enabled in the Display menu'
endif # BOOTSPLASH

config SEABIOS_ADD_BOOTSPLASH
	bool "Add bootsplash file for SeaBIOS to CBFS"
	depends on !BOOTSPLASH
	default y if !BOOTSPLASH
	help
	  Add a bootsplash file, which SeaBIOS will display before the
	  F12 prompt.  Depends on having a VGA BIOS in CBFS or having
	  a plug-in graphics card that provides its own option ROM.

if !BOOTSPLASH && SEABIOS_ADD_BOOTSPLASH

config SEABIOS_BOOTSPLASH_FILE
	string "bootsplash path and filename"
	default "../sage/sage_eval.jpg"
	help
	  The path and filename of the file to use as graphical bootsplash
	  screen. The file format has to be jpg.

config SEABIOS_BOOTSPLASH_LZMA
	bool "Compress the bootsplash image in CBFS"
	help
	  Compress the bootsplash image using lzma.

config SEABIOS_BOOTSPLASH_ADDRESS
	string "bootsplash image address in CBFS"
	help
	  Place the bootsplash image at a specific address.  If left blank,
	  the bootsplash image will be placed at an unused address range in CBFS.
	  If an address is specified, it must point to an unused range within the
	  boot ROM device.

endif # !BOOTSPLASH && SEABIOS_ADD_BOOTSPLASH

config SEABIOS_ADD_BOOT_MENU_WAIT
	bool "Add a SeabBIOS BOOT-MENU-WAIT file to CBFS"
	default y
	help
	  This modifies SeaBIOS's default delay when pausing at the
	  'Press XXX for Boot Menu' prompt

config SEABIOS_BOOT_MENU_WAIT_TIME
	int "BOOT-MENU-WAIT time in msecs"
	depends on SEABIOS_ADD_BOOT_MENU_WAIT
	default -1
	help
	  This modifies SeaBIOS's default delay when pausing at the
	  'Press XXX for Boot Menu' prompt.  A value of -1 (4294967295)
	  causes SeaBIOS to wait for a keypress indefinitely.

config SEABIOS_ADD_BOOT_MENU_KEY
	bool "Add a SeabBIOS BOOT-MENU-KEY file to CBFS"
	default n
	help
	  This changes the key that takes SeaBIOS into the boot menu.
	  The built-in default is F12.

config SEABIOS_BOOT_MENU_KEY
	string "BOOT-MENU-KEY value"
	depends on SEABIOS_ADD_BOOT_MENU_KEY
	default 0x0000003231460086
	help
	  This is an encoded scancode and text { u16 code; char text[6]; }.
	  Popular choices:
	    ESC = 0x0000004353450001
	    F1  = 0x000000003146003b
	    F2  = 0x000000003246003c
	    F12 = 0x0000003231460086

config SEABIOS_PS2_TIMEOUT
	prompt "PS/2 keyboard controller initialization timeout (milliseconds)"
	default 0
	int
	help
	  Some PS/2 keyboard controllers don't respond to commands immediately
	  after powering on. This specifies how long SeaBIOS will wait for the
	  keyboard controller to become ready before giving up.

config SEABIOS_THREAD_OPTIONROMS
	prompt "Hardware init during option ROM execution"
	default n
	bool
	help
	  Allow hardware init to run in parallel with optionrom execution.

	  This can reduce boot time, but can cause some timing
	  variations during option ROM code execution. It is not
	  known if all option ROMs will behave properly with this option.

config SEABIOS_VGA_COREBOOT
	prompt "Include generated option rom that implements legacy VGA BIOS compatibility"
	default n
	depends on !VGA_BIOS && (MAINBOARD_DO_NATIVE_VGA_INIT || MAINBOARD_HAS_NATIVE_VGA_INIT_TEXTMODECFG)
	bool
	help
	  Coreboot can initialize the GPU of some mainboards.

	  After initializing the GPU, the information about it can be passed to the payload.
	  Provide an option rom that implements this legacy VGA BIOS compatibility requirement.

config PAYLOAD_CONFIGFILE
	string "SeaBIOS config file"
	default ""
	help
	  This option allows a platform to set Kconfig options for a basic
	  SeaBIOS payload.  In general, if the option is used, the default
	  would be "$(top)/src/mainboard/$(MAINBOARDDIR)/config_seabios"

config PAYLOAD_FILE
	default "payloads/external/SeaBIOS/seabios/out/bios.bin.elf"

config PAYLOAD_VGABIOS_FILE
	string
	depends on SEABIOS_VGA_COREBOOT
	default "payloads/external/SeaBIOS/seabios/out/vgabios.bin"

endmenu
endif
```

## src/mainboard/wabtec/cpu1903/Kconfig
```kconfig
##
## This file is part of the coreboot project.
##
## Copyright (C) 2013-2014 Sage Electronic Engineering, LLC.
##
## This program is free software; you can redistribute it and/or modify
## it under the terms of the GNU General Public License as published by
## the Free Software Foundation; version 2 of the License.
##
## This program is distributed in the hope that it will be useful,
## but WITHOUT ANY WARRANTY; without even the implied warranty of
## MERCHANTABILITY or FITNESS FOR A PARTICULAR PURPOSE.  See the
## GNU General Public License for more details.
##
## You should have received a copy of the GNU General Public License
## along with this program; if not, write to the Free Software
## Foundation, Inc.
##

if BOARD_WABTEC_CPU1903

config BOARD_SPECIFIC_OPTIONS # dummy
	def_bool y
	select ARCH_X86
	select SOC_INTEL_FSP_BAYTRAIL
	select BOARD_ROMSIZE_KB_16384
	select HAVE_ACPI_TABLES
	select HAVE_OPTION_TABLE
	select HAVE_CMOS_DEFAULT
	select POST_IO
	select ENABLE_BUILTIN_COM1 if FSP_PACKAGE_DEFAULT
	select HAVE_FSP_BIN if FSP_PACKAGE_DEFAULT
	select TSC_MONOTONIC_TIMER

config MAINBOARD_DIR
	string
	default "wabtec/cpu1903"

config MAINBOARD_PART_NUMBER
	string
	default "CPU1903"

config MAX_CPUS
	int
	default 16

config CACHE_ROM_SIZE_OVERRIDE
	hex
	default 0x800000

config FSP_FILE
	string
	default "../intel/fsp/baytrail/SageFSP_BayleyBay_99_release.bin"

config MRC_CACHE_LOC
	hex
	default 0xfff80000
	depends on ENABLE_FSP_FAST_BOOT

config CBFS_SIZE
	hex
	default 0x00680000

config ENABLE_FSP_FAST_BOOT
	bool
	depends on HAVE_FSP_BIN
	default y

config VIRTUAL_ROM_SIZE
	hex
	depends on ENABLE_FSP_FAST_BOOT
	default 0x800000

config FSP_PACKAGE_DEFAULT
	bool "Configure defaults for the Intel FSP package"
	default n

config VGA_BIOS
	bool
	default y if FSP_PACKAGE_DEFAULT

config DRIVERS_PS2_KEYBOARD
	bool
	default n

endif # BOARD_WABTEC_CPU1903
```

## src/mainboard/wabtec/cpu1903/Kconfig.name
```kconfig
config BOARD_WABTEC_CPU1903
	bool "CPU1903 based on the Bayley Bay FSP-based CRB"
```
